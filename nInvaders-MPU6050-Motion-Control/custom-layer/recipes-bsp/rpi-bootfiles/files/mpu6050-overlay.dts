/dts-v1/;
/plugin/;

/ {
    compatible = "brcm,bcm2711", "brcm,bcm2835";

    fragment@0 {
        target = <&i2c1>;
        __overlay__ {
            status = "okay";
            pinctrl-0 = <&i2c1_pins>;
            pinctrl-names = "default";
            clock-frequency = <400000>;
            #address-cells = <1>;
            #size-cells = <0>;

            mpu6050@68 {
                compatible = "invensense,mpu6050";
                reg = <0x68>;
                interrupt-parent = <&gpio>;
                interrupts = <23 1>;
            };
        };
    };
};
